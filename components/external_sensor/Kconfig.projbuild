## components/external_sensor/Kconfig.projbuild
```kconfig
menu "External sensor"

    config EXTERNAL_SENSOR_PIN
        int "GPIO external sensor pin"
        range 0 36
        default 32
        help
            GPIO pin number to be system calculated distance and speed.

endmenu
```

## components/power_manager/Kconfig.projbuild
```kconfig
menu "Power Manager"

    config EXTERNAL_POWER_PIN
        int "GPIO external power pin"
        range 0 36
        default 32
        help
            GPIO pin number to be system enabled.

    config EXTERNAL_POWER_PIN_INVERTED
        bool "Inverted value from external pin?"
        default FALSE
        help
            Inverted value from external power pin.

endmenu
```

## components/pump/Kconfig.projbuild
```kconfig
menu "Pump"

    config PUMP_CONTROL_PIN
        int "GPIO pump control pin"
        range 0 36
        default 17
        help
            GPIO pin number to be pump enabled.

    config PUMP_FEEDBACK_PIN
        int "GPIO pump feedback pin"
        range 0 36
        default 16
        help
            GPIO pin number to be pump feedback.

    config PUMP_FEEDBACK_IGNORE
        bool "GPIO pump feedback pin value ignore"
        default FALSE
        help
            Ignoring the feedback pin value.

endmenu
```

## sdkconfig.defaults
```kconfig
#
# Serial flasher config
#
CONFIG_ESPTOOLPY_HEADER_FLASHSIZE_UPDATE=y

#
# Partition Table
#
CONFIG_PARTITION_TABLE_TWO_OTA_LARGE=y
CONFIG_PARTITION_TABLE_FILENAME="partitions_two_ota_large.csv"

#
# BT config
#
CONFIG_BT_ENABLED=y
CONFIG_BTDM_CTRL_MODE_BLE_ONLY=y
CONFIG_BTDM_CTRL_MODE_BR_EDR_ONLY=n
CONFIG_BTDM_CTRL_MODE_BTDM=n
CONFIG_BT_BLUEDROID_ENABLED=n
CONFIG_BT_NIMBLE_ENABLED=y
```
